;
; 3.asm
;
; Created: 12.09.2022 13:22:01
; Author : ve3xone
;
.def temp = r20
.def temp1 = r19
.def temp2 = r18
.def temp3 = r17
.device ATMEGA16
.include "m16def.inc"
.org 0x00

.macro readarraymain
		ldi r23,@2
		out PORTd,r23
		ldi r23,@1
		out PORTa,r23
		call strob
		ldi r23,@3
		out PORTd,r23
		ldi ZH,High(@0*2)  ;загрузка начального адреса массива
        ldi ZL,Low(@0*2)
		ldi r19,64
		loop:
		lpm r16,Z+
		out porta, r16
		call strob
		dec r19
		brne loop
.endmacro

; Replace with your application code

//Инициализация МК-------------------------------
INIT:
ldi r16,0b11111111
out DDRa,r16
ldi r17,0b00111111
out DDRd,r17
//Инициализация стека----------
ldi r16,low(ramEND)
out SPL,r16
ldi r16,high(ramEND)
out SPH,r16
//----------------------------
//Инициализация дисплея----------
ldi r23,0b00000000
out PORTd,r23
call WAIT_5ms
ldi r23,0b00101000
out PORTd,r23
call WAIT_5ms
ldi r23,0b00101000
out PORTd,r23
call WAIT_5ms
ldi r23, 0x3f
out PORTa,r23
call strob
call WAIT_5ms
ldi r23, 0x40
out PORTa,r23
call strob
call WAIT_5ms
ldi r23, 0xB8
out PORTa,r23
call strob
call WAIT_5ms
call WAIT_5ms
ldi r23, 0xC0
out PORTa,r23
call strob
call WAIT_5ms

readarray:
readarraymain Array1_1,0xB8,0b00101000,0b00101001
readarraymain Array1_2,0xB9,0b00101000,0b00101001
readarraymain Array1_3,0xBA,0b00101000,0b00101001
readarraymain Array1_4,0xBb,0b00101000,0b00101001
readarraymain Array1_5,0xBc,0b00101000,0b00101001
readarraymain Array1_6,0xBd,0b00101000,0b00101001
readarraymain Array1_7,0xBe,0b00101000,0b00101001
readarraymain Array1_8,0xBf,0b00101000,0b00101001

readarraymain Array2_1,0xB8,0b00110000,0b00110001
readarraymain Array2_2,0xB9,0b00110000,0b00110001
readarraymain Array2_3,0xBA,0b00110000,0b00110001
readarraymain Array2_4,0xBB,0b00110000,0b00110001
readarraymain Array2_5,0xBC,0b00110000,0b00110001
readarraymain Array2_6,0xBD,0b00110000,0b00110001
readarraymain Array2_7,0xBE,0b00110000,0b00110001
readarraymain Array2_8,0xBF,0b00110000,0b00110001

loopend:

rjmp loopend

strob:
	sbi portd,2
	nop
	cbi portd,2
ret

WAIT_5ms: ;Расчет делался в программе
; =============================
; delay loop generator
; 40000 cycles:
; -----------------------------
; delaying 39999 cycles:
ldi R17, $43
WGLOOP02: ldi R18, $C6
WGLOOP12: dec R18
brne WGLOOP12
dec R17
brne WGLOOP02
; -----------------------------
; delaying 1 cycle:
nop
; =============================
ret

;                         **** КРИСТАЛЛ 1 ****

Array1_1:
            .db            0x00,0xF8,0xF8,0xF8,0xFC,0xF8,0xE0,0xF8
            .db            0xE2,0xFC,0xF4,0xFA,0xF8,0xFC,0xF8,0xFC
            .db            0xFC,0xFE,0xFE,0xFF,0xFF,0xFF,0xFF,0xFF
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            .db            0x00,0x00,0x00,0x00,0x00,0x00,0x00,0x00
Array1_2:
            .db            0x00,0xFF,0xFF,0xFF,0xFF,0xFF,0xFF,0xFF
            .db            0xFF,0xFF,0xFF,0xFF,0xFF,0xFF,0xFF,0xFF
            .db            0xFF,0xFF,0xFF,0xFF,0xFF,0xFF,0xFF,0xFF
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            .db            0x0D,0x08,0x00,0x00,0x00,0x00,0x00,0x00
Array1_3:
            .db            0xA5,0xFF,0xFF,0xFF,0xFF,0xFF,0xFF,0xFF
            .db            0xFF,0xFF,0xFF,0xFF,0xFF,0xFF,0xFF,0xFF
            .db            0xFF,0xFF,0xFF,0xFF,0xFF,0xFF,0xFF,0xFF
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            .db            0xFC,0xFC,0xFC,0xF8,0xFC,0xFC,0xFC,0xFC
Array1_4:
            .db            0xFE,0xFF,0xFF,0xFF,0xFF,0xFF,0xFF,0xFF
            .db            0xFF,0xFF,0xFF,0xFF,0xFF,0xFF,0xFF,0xFF
            .db            0xFF,0xFF,0xFF,0xFF,0xFF,0xFF,0xFF,0xFF
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            .db            0xFF,0xFF,0xFF,0xFF,0xFF,0xFF,0xFF,0xFF
Array1_5:
            .db            0xFF,0xFF,0xFF,0xFF,0xFF,0xFF,0xFF,0xFF
            .db            0xFF,0xFF,0xFF,0xFF,0xFF,0xFF,0xFF,0xFF
            .db            0xFF,0xFF,0xFF,0xFF,0xFF,0xFF,0xFF,0xFF
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            .db            0xFF,0xFF,0xFF,0xFF,0xFF,0xFF,0xFF,0xFF
Array1_6:
            .db            0xFF,0xFF,0xFF,0xFF,0xFF,0xFF,0xFF,0xFF
            .db            0xFF,0xFF,0xFF,0xFF,0xFF,0xFF,0xFF,0xFF
            .db            0xFF,0xFF,0xFF,0xFF,0xFF,0xFF,0xFF,0xFF
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            .db            0xFF,0xFF,0xFF,0xFF,0xFF,0xFF,0xFF,0xFF
Array1_7:
            .db            0xFF,0xFF,0xFF,0xFF,0xFF,0xFF,0xFF,0xFF
            .db            0xFF,0xFF,0xFF,0xFF,0xFF,0xFF,0xFF,0xFF
            .db            0xFF,0xFF,0xFF,0xFF,0xFF,0xFF,0x7F,0x3F
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            .db            0xFF,0xFF,0xFF,0xFF,0xFF,0xFF,0xFF,0xFF
Array1_8:
            .db            0xFF,0xFF,0xFF,0xFF,0xFF,0xFF,0xFF,0xFF
            .db            0xFF,0xFF,0xFF,0xFF,0xFF,0xFF,0xFF,0xFF
            .db            0xFF,0xFF,0xFF,0xFF,0xFF,0xF0,0xE0,0xC0
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            .db            0x80,0x80,0x80,0x80,0xB6,0xB6,0xB6,0xB6


;                          **** КРИСТАЛЛ 2 ****

Array2_1:
            .db            0x20,0x60,0xE0,0xE0,0xE0,0xF0,0xF0,0xF0
            .db            0xF0,0xF8,0xF0,0xF0,0xF8,0xF8,0xF8,0xF8
            .db            0xF8,0xF8,0xF8,0xF8,0xF0,0xF0,0xF0,0xF0
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            .db            0xFF,0xFF,0xFF,0xFF,0xFF,0xFF,0xFF,0xFF
Array2_2:
            .db            0x00,0x00,0x30,0x3E,0xFF,0xFF,0xFF,0xFF
            .db            0xFF,0xFF,0xFF,0xFF,0xFF,0xFF,0xFF,0xFF
            .db            0xFF,0xFF,0xFF,0xFF,0xFF,0xFF,0xFF,0xFF
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            .db            0xFF,0xFF,0xFF,0xFF,0xFF,0xFF,0xFF,0xFF
Array2_3:
            .db            0xFE,0xFE,0xFE,0xFE,0xFD,0xFF,0xFF,0xFF
            .db            0xFF,0xFE,0xF8,0xF1,0xE0,0xC1,0x01,0x01
            .db            0x01,0x03,0x03,0x03,0x03,0x07,0x07,0x07
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            .db            0xFF,0xFF,0xFF,0xFF,0xFF,0xFF,0xFF,0xFF
Array2_4:
            .db            0xFF,0xFF,0xFF,0xFF,0xFF,0xFF,0xFF,0xFF
            .db            0xFF,0xFF,0xFF,0xFF,0xFF,0xFF,0xFC,0xFC
            .db            0xFC,0xFC,0xF8,0xF8,0xF0,0xF0,0xE0,0xF0
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            .db            0xFF,0xFF,0xFF,0xFF,0xFF,0xFF,0xFF,0xFF
Array2_5:
            .db            0xFF,0xFF,0xFF,0xFF,0xFF,0xFF,0xFF,0xFF
            .db            0xFF,0xFF,0xFF,0xFF,0xFF,0xFF,0xFF,0xFF
            .db            0xFF,0xFF,0xFF,0x7F,0xFF,0xFF,0x7F,0xFF
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            .db            0xFF,0xFF,0xFF,0xFF,0xFF,0xFF,0xFF,0xFF
Array2_6:
            .db            0xFF,0xFF,0xFF,0xFF,0xFF,0xFF,0xFF,0xFF
            .db            0xFF,0xFF,0xFF,0xFF,0xFB,0xFD,0xFD,0xFC
            .db            0xFD,0xFC,0xFE,0xFC,0xFD,0xFB,0xFB,0xFD
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            .db            0xFF,0xFF,0xFF,0xFF,0xFF,0xFF,0xFF,0xFF
Array2_7:
            .db            0xFF,0xFF,0xFF,0xFF,0xFF,0xFF,0xFF,0xFF
            .db            0xFF,0xFF,0xFF,0xFF,0xFF,0xFF,0xFF,0xFF
            .db            0xFF,0xFF,0xFF,0xFF,0xFF,0xFF,0xFF,0xFF
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            .db            0xFF,0xFF,0xFF,0xFF,0xFF,0xFF,0xFF,0xFF
Array2_8:
            .db            0xB0,0x80,0x80,0xC9,0xCF,0xFF,0xFF,0xCD
            .db            0x85,0x84,0x84,0xB6,0xB6,0xB6,0xB6,0xD4
            .db            0xC0,0x80,0x81,0xFF,0xFF,0xFF,0xBF,0x9F
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            .db            0xFF,0xFF,0xFF,0xFF,0xFF,0xFF,0xFF,0xFF